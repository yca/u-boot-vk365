## board/aselsan/vk365/Kconfig
```kconfig
if TARGET_ASELSAN_VK365

config SYS_BOARD
	default "vk365"

config SYS_VENDOR
	default "aselsan"

config SYS_CONFIG_NAME
	default "vk365"

endif
```

## configs/vk365_defconfig
```kconfig
CONFIG_SPL=y
+S:CONFIG_ARM=y
+S:CONFIG_ARCH_DAVINCI=y
+S:CONFIG_TARGET_ASELSAN_VK365=y
```
